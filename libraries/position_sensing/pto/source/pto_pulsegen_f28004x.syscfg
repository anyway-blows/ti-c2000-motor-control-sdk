// These arguments were used when this file was generated. They will be automatically applied on subsequent loads 
// via the GUI or CLI invocations. Run CLI with '--help' for additional information on how to override these arguments.
// @cliArgs --device "F28004x" --package "F28004x_100PZ" --part "F28004x_100PZ"
// @versions {"data":"2019020517","timestamp":"2019020517","tool":"1.0.655","templates":"2019020517"}

var TILE = scripting.addModule("/utilities/clb_tool/clb_syscfg/source/TILE");
var TILE1 = TILE.addInstance();
// clock_period - Period of the clock (in Nano Seconds) used for simulation in System C
TILE.clock_period = 10;
// sim_duration - Duration of the simulation (in Nano Seconds)
TILE.sim_duration = 4000000;
// Name
TILE1.$name = "TILE1";
// Name
TILE1.BOUNDARY.$name = "BOUNDARY0";
// in_repeat_count3 - Number of periods the waveform is repeated
TILE1.BOUNDARY.in_repeat_count3 = 1;
// in0
TILE1.BOUNDARY.in0 = "squareWave";
// in1
TILE1.BOUNDARY.in1 = "squareWave";
// in7
TILE1.BOUNDARY.in7 = "1";
// in_repeat_count1 - Number of periods the waveform is repeated
TILE1.BOUNDARY.in_repeat_count1 = 1000;
// in_edge1 - Edge detection on the inputs, generates 1 cycle pulse on chosen edges - for simulation purposes only
TILE1.BOUNDARY.in_edge1 = "rising edge";
// in_period0 - Period of the square wave
TILE1.BOUNDARY.in_period0 = 200000;
// in_duty0 - Duty or ON time of the square wave
TILE1.BOUNDARY.in_duty0 = 100000;
// in_repeat_count0 - Number of periods the waveform is repeated
TILE1.BOUNDARY.in_repeat_count0 = 2;
// in2
TILE1.BOUNDARY.in2 = "squareWave";
// in_period2 - Period of the square wave
TILE1.BOUNDARY.in_period2 = 10000;
// in_duty2 - Duty or ON time of the square wave
TILE1.BOUNDARY.in_duty2 = 5000;
// in_period1 - Period of the square wave
TILE1.BOUNDARY.in_period1 = 10000;
// in_duty1 - Duty or ON time of the square wave
TILE1.BOUNDARY.in_duty1 = 5000;
// in_repeat_count2 - Number of periods the waveform is repeated
TILE1.BOUNDARY.in_repeat_count2 = 1000;
// in4
TILE1.BOUNDARY.in4 = "squareWave";
// in_period4 - Period of the square wave
TILE1.BOUNDARY.in_period4 = 50000;
// in_duty4 - Duty or ON time of the square wave
TILE1.BOUNDARY.in_duty4 = 25000;
// in_repeat_count4 - Number of periods the waveform is repeated
TILE1.BOUNDARY.in_repeat_count4 = 1000;
// Name
TILE1.LUT_0.$name = "LUT_0";
// i1 - Input 1.
TILE1.LUT_0.i1 = "BOUNDARY.in1";
// i2 - Input 2.
TILE1.LUT_0.i2 = "COUNTER_1.count_match2";
// eqn - Boolean equation on the variables i3,i2,i1,i0 for the LUT output.
TILE1.LUT_0.eqn = "i0 & (i1 | i2)";
// i0 - Input 0.
TILE1.LUT_0.i0 = "BOUNDARY.in0";
// Name
TILE1.LUT_1.$name = "LUT_1";
// eqn - Boolean equation on the variables i3,i2,i1,i0 for the LUT output.
TILE1.LUT_1.eqn = "i0 & i1";
// i0 - Input 0.
TILE1.LUT_1.i0 = "BOUNDARY.in2";
// i1 - Input 1.
TILE1.LUT_1.i1 = "BOUNDARY.in0";
// Name
TILE1.LUT_2.$name = "LUT_2";
// eqn - Boolean equation on the variables i3,i2,i1,i0 for the LUT output.
TILE1.LUT_2.eqn = "0";
// Name
TILE1.FSM_0.$name = "FSM_0";
// e0 - External Input 0.
TILE1.FSM_0.e0 = "COUNTER_0.count_match1";
// eqn_s1 - Boolean equation on the variables e1,e0,s1,s0 for the S1 output.
TILE1.FSM_0.eqn_s1 = "s1";
// eqn_s0 - Boolean equation on the variables e1,e0,s1,s0 for the S0 output.
TILE1.FSM_0.eqn_s0 = "((~s0) & (e0 & (~e1))) |  (s0& (~e1))";
// e1 - External Input 1.
TILE1.FSM_0.e1 = "COUNTER_0.count_match2";
// xe0 - Extra External Input 0.
TILE1.FSM_0.xe0 = "FSM_1.S0";
// xe1 - Extra External Input 1.
TILE1.FSM_0.xe1 = "COUNTER_1.count_match2";
// eqn_out - Boolean equation on the variables e1,e0,s1,s0 for the LUT output.
TILE1.FSM_0.eqn_out = "xe0 | xe1 | e1";
// Name
TILE1.FSM_1.$name = "FSM_1";
// e1 - External Input 1.
TILE1.FSM_1.e1 = "COUNTER_1.count_match2";
// eqn_out - Boolean equation on the variables e1,e0,s1,s0 for the LUT output.
TILE1.FSM_1.eqn_out = "s0 | s1";
// eqn_s1 - Boolean equation on the variables e1,e0,s1,s0 for the S1 output.
TILE1.FSM_1.eqn_s1 = "s0";
// e0 - External Input 0.
TILE1.FSM_1.e0 = "COUNTER_1.count_match1";
// eqn_s0 - Boolean equation on the variables e1,e0,s1,s0 for the S0 output.
TILE1.FSM_1.eqn_s0 = "((~s0)&(e0 & (~e1))) | ((s0) & (~e1))";
// Name
TILE1.FSM_2.$name = "FSM_2";
// eqn_s1 - Boolean equation on the variables e1,e0,s1,s0 for the S1 output.
TILE1.FSM_2.eqn_s1 = "s1";
// eqn_out - Boolean equation on the variables e1,e0,s1,s0 for the LUT output.
TILE1.FSM_2.eqn_out = "s0";
// e0 - External Input 0.
TILE1.FSM_2.e0 = "BOUNDARY.in4";
// e1 - External Input 1.
TILE1.FSM_2.e1 = "LUT_0.OUT";
// eqn_s0 - Boolean equation on the variables e1,e0,s1,s0 for the S0 output.
TILE1.FSM_2.eqn_s0 = "((~s0) & (e0 & e1)) | (s0 & (e0 | (~e1)))";
// Name
TILE1.COUNTER_0.$name = "COUNTER_0";
// reset - Reset the counter to 0 on next clock cycle (triggers low to high)
TILE1.COUNTER_0.reset = "FSM_0.OUT";
// mode0 - Enables Counting when high
TILE1.COUNTER_0.mode0 = "LUT_1.OUT";
// mode1 - Controls counting direction. High enables count up. Low enables count down.
TILE1.COUNTER_0.mode1 = "1";
// Name
TILE1.COUNTER_1.$name = "COUNTER_1";
// reset - Reset the counter to 0 on next clock cycle (triggers low to high)
TILE1.COUNTER_1.reset = "COUNTER_1.count_match2";
// mode0 - Enables Counting when high
TILE1.COUNTER_1.mode0 = "LUT_1.OUT";
// mode1 - Controls counting direction. High enables count up. Low enables count down.
TILE1.COUNTER_1.mode1 = "1";
// Name
TILE1.COUNTER_2.$name = "COUNTER_2";
// match1_val - Sets the value of the Match reference 1 register.
TILE1.COUNTER_2.match1_val = "40";
// reset - Reset the counter to 0 on next clock cycle (triggers low to high)
TILE1.COUNTER_2.reset = "COUNTER_2.count_match2";
// mode0 - Enables Counting when high
TILE1.COUNTER_2.mode0 = "LUT_1.OUT";
// mode1 - Controls counting direction. High enables count up. Low enables count down.
TILE1.COUNTER_2.mode1 = "1";
// Name
TILE1.OUTLUT_0.$name = "OUTLUT_0";
// Name
TILE1.OUTLUT_1.$name = "OUTLUT_1";
// Name
TILE1.OUTLUT_2.$name = "OUTLUT_2";
// Name
TILE1.OUTLUT_3.$name = "OUTLUT_3";
// eqn - Boolean equation on the variables i2,i1,i0 for the OUTLUT output.
TILE1.OUTLUT_3.eqn = "0";
// Name
TILE1.OUTLUT_4.$name = "OUTLUT_4";
// i0 - Input 0.
TILE1.OUTLUT_4.i0 = "FSM_0.S0";
// i1 - Input 1.
TILE1.OUTLUT_4.i1 = "BOUNDARY.in0";
// eqn - Boolean equation on the variables i2,i1,i0 for the OUTLUT output.
TILE1.OUTLUT_4.eqn = "i0 & i1";
// Name
TILE1.OUTLUT_5.$name = "OUTLUT_5";
// i0 - Input 0.
TILE1.OUTLUT_5.i0 = "FSM_2.S0";
// eqn - Boolean equation on the variables i2,i1,i0 for the OUTLUT output.
TILE1.OUTLUT_5.eqn = "i0";
// Name
TILE1.OUTLUT_6.$name = "OUTLUT_6";
// Name
TILE1.OUTLUT_7.$name = "OUTLUT_7";
// Name
TILE1.HLC.$name = "HLC_0";
// R0_init - Initial value for register R0
TILE1.HLC.R0_init = "19";
// R1_init - Initial value for register R1
TILE1.HLC.R1_init = "39";
// R2_init - Initial value for register R2
TILE1.HLC.R2_init = "199";
// R3_init - Initial value for register R3
TILE1.HLC.R3_init = "199";
// Event 0 (e0) - Event 0
TILE1.HLC.e0 = "LUT_0.OUT";
// Event 1 (e1) - Event 1
TILE1.HLC.e1 = "COUNTER_2.count_match1";
// Name
TILE1.HLC.program0.$name = "HLCP_0";
// instruct0
TILE1.HLC.program0.instruct0 = "MOV_T1 R0, C0";
// instruct1
TILE1.HLC.program0.instruct1 = "MOV_T2 R1, C0";
// instruct2
TILE1.HLC.program0.instruct2 = "MOV_T1 R2, C1";
// instruct3
TILE1.HLC.program0.instruct3 = "MOV_T2 R3, C1";
// instruct4
TILE1.HLC.program0.instruct4 = "MOV_T2 R3, C2";
// Name
TILE1.HLC.program1.$name = "HLCP_1";
// instruct0
TILE1.HLC.program1.instruct0 = "INTR 1";
// Name
TILE1.HLC.program2.$name = "HLCP_2";
// Name
TILE1.HLC.program3.$name = "HLCP_3";
