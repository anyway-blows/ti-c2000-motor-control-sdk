// These arguments were used when this file was generated. They will be automatically applied on subsequent loads 
// via the GUI or CLI invocations. Run CLI with '--help' for additional information on how to override these arguments.
// @cliArgs --device "F28004x" --package "F28004x_100PZ" --part "F28004x_100PZ"
// @versions {"data":"2019020517","timestamp":"2019020517","tool":"1.0.655","templates":"2019020517"}

var TILE = scripting.addModule("/utilities/clb_tool/clb_syscfg/source/TILE");
var TILE1 = TILE.addInstance();
var TILE2 = TILE.addInstance();
// clock_period - Period of the clock (in Nano Seconds) used for simulation in System C
TILE.clock_period = 10;
// sim_duration - Duration of the simulation (in Nano Seconds)
TILE.sim_duration = 40000;
// Name
TILE1.$name = "TILE1";
// Name
TILE1.BOUNDARY.$name = "BOUNDARY0";
// in_repeat_count3 - Number of periods the waveform is repeated
TILE1.BOUNDARY.in_repeat_count3 = 1;
// in1
TILE1.BOUNDARY.in1 = "squareWave";
// in_period0 - Period of the square wave
TILE1.BOUNDARY.in_period0 = 200000;
// in_duty0 - Duty or ON time of the square wave
TILE1.BOUNDARY.in_duty0 = 100000;
// in_repeat_count0 - Number of periods the waveform is repeated
TILE1.BOUNDARY.in_repeat_count0 = 2;
// in2
TILE1.BOUNDARY.in2 = "squareWave";
// in4
TILE1.BOUNDARY.in4 = "squareWave";
// in5
TILE1.BOUNDARY.in5 = "squareWave";
// in7
TILE1.BOUNDARY.in7 = "squareWave";
// in_edge7 - Edge detection on the inputs, generates 1 cycle pulse on chosen edges - for simulation purposes only
TILE1.BOUNDARY.in_edge7 = "rising edge";
// in_edge2 - Edge detection on the inputs, generates 1 cycle pulse on chosen edges - for simulation purposes only
TILE1.BOUNDARY.in_edge2 = "both edges";
// in_edge5 - Edge detection on the inputs, generates 1 cycle pulse on chosen edges - for simulation purposes only
TILE1.BOUNDARY.in_edge5 = "both edges";
// in_period4 - Period of the square wave
TILE1.BOUNDARY.in_period4 = 500;
// in_duty4 - Duty or ON time of the square wave
TILE1.BOUNDARY.in_duty4 = 250;
// in_period2 - Period of the square wave
TILE1.BOUNDARY.in_period2 = 500;
// in_duty2 - Duty or ON time of the square wave
TILE1.BOUNDARY.in_duty2 = 250;
// in_period1 - Period of the square wave
TILE1.BOUNDARY.in_period1 = 500;
// in_duty1 - Duty or ON time of the square wave
TILE1.BOUNDARY.in_duty1 = 250;
// in_period5 - Period of the square wave
TILE1.BOUNDARY.in_period5 = 500;
// in_duty5 - Duty or ON time of the square wave
TILE1.BOUNDARY.in_duty5 = 250;
// in0
TILE1.BOUNDARY.in0 = "1";
// in_period7 - Period of the square wave
TILE1.BOUNDARY.in_period7 = 3000;
// in_duty7 - Duty or ON time of the square wave
TILE1.BOUNDARY.in_duty7 = 1500;
// Name
TILE1.LUT_0.$name = "LUT_0";
// Name
TILE1.LUT_1.$name = "LUT_1";
// eqn - Boolean equation on the variables i3,i2,i1,i0 for the LUT output.
TILE1.LUT_1.eqn = "(((~i0) & (~i1)) & i3) | (((~i0) & i1) & i2) | ((i0 & (~i1)) & i2) | ((i0 & i1) & i3) ";
// i0 - Input 0.
TILE1.LUT_1.i0 = "FSM_0.S0";
// i1 - Input 1.
TILE1.LUT_1.i1 = "FSM_0.S1";
// i2 - Input 2.
TILE1.LUT_1.i2 = "BOUNDARY.in2";
// i3 - Input 3.
TILE1.LUT_1.i3 = "BOUNDARY.in5";
// Name
TILE1.LUT_2.$name = "LUT_2";
// eqn - Boolean equation on the variables i3,i2,i1,i0 for the LUT output.
TILE1.LUT_2.eqn = "0";
// Name
TILE1.FSM_0.$name = "FSM_0";
// eqn_s0 - Boolean equation on the variables e1,e0,s1,s0 for the S0 output.
TILE1.FSM_0.eqn_s0 = "e0";
// eqn_s1 - Boolean equation on the variables e1,e0,s1,s0 for the S1 output.
TILE1.FSM_0.eqn_s1 = "e1";
// eqn_out - Boolean equation on the variables e1,e0,s1,s0 for the LUT output.
TILE1.FSM_0.eqn_out = "s0 | s1";
// e0 - External Input 0.
TILE1.FSM_0.e0 = "BOUNDARY.in1";
// e1 - External Input 1.
TILE1.FSM_0.e1 = "BOUNDARY.in4";
// xe0 - Extra External Input 0.
TILE1.FSM_0.xe0 = "BOUNDARY.in2";
// xe1 - Extra External Input 1.
TILE1.FSM_0.xe1 = "BOUNDARY.in5";
// Name
TILE1.FSM_1.$name = "FSM_1";
// e0 - External Input 0.
TILE1.FSM_1.e0 = "LUT_1.OUT";
// e1 - External Input 1.
TILE1.FSM_1.e1 = "FSM_0.OUT";
// eqn_s1 - Boolean equation on the variables e1,e0,s1,s0 for the S1 output.
TILE1.FSM_1.eqn_s1 = "s1";
// eqn_s0 - Boolean equation on the variables e1,e0,s1,s0 for the S0 output.
TILE1.FSM_1.eqn_s0 = "((~s0) & e0 & e1) | (s0 & (~e1) | e0) ";
// eqn_out - Boolean equation on the variables e1,e0,s1,s0 for the LUT output.
TILE1.FSM_1.eqn_out = "s0 & s1";
// Name
TILE1.FSM_2.$name = "FSM_2";
// eqn_s1 - Boolean equation on the variables e1,e0,s1,s0 for the S1 output.
TILE1.FSM_2.eqn_s1 = "s1";
// eqn_s0 - Boolean equation on the variables e1,e0,s1,s0 for the S0 output.
TILE1.FSM_2.eqn_s0 = "((~s0) & e0) | (s0 & (~e1))";
// eqn_out - Boolean equation on the variables e1,e0,s1,s0 for the LUT output.
TILE1.FSM_2.eqn_out = "~s0";
// e0 - External Input 0.
TILE1.FSM_2.e0 = "BOUNDARY.in7";
// e1 - External Input 1.
TILE1.FSM_2.e1 = "COUNTER_2.count_match1";
// Name
TILE1.COUNTER_0.$name = "COUNTER_0";
// match1_val - Sets the value of the Match reference 1 register.
TILE1.COUNTER_0.match1_val = "20";
// mode0 - Enables Counting when high
TILE1.COUNTER_0.mode0 = "1";
// mode1 - Controls counting direction. High enables count up. Low enables count down.
TILE1.COUNTER_0.mode1 = "1";
// match2_val - Sets the value of the Match reference 2 register.
TILE1.COUNTER_0.match2_val = "40";
// Name
TILE1.COUNTER_1.$name = "COUNTER_1";
// match1_val - Sets the value of the Match reference 1 register.
TILE1.COUNTER_1.match1_val = "10";
// match2_val - Sets the value of the Match reference 2 register.
TILE1.COUNTER_1.match2_val = "20";
// mode0 - Enables Counting when high
TILE1.COUNTER_1.mode0 = "1";
// mode1 - Controls counting direction. High enables count up. Low enables count down.
TILE1.COUNTER_1.mode1 = "1";
// Name
TILE1.COUNTER_2.$name = "COUNTER_2";
// mode1 - Controls counting direction. High enables count up. Low enables count down.
TILE1.COUNTER_2.mode1 = "1";
// match1_val - Sets the value of the Match reference 1 register.
TILE1.COUNTER_2.match1_val = "8";
// match2_val - Sets the value of the Match reference 2 register.
TILE1.COUNTER_2.match2_val = "4";
// reset - Reset the counter to 0 on next clock cycle (triggers low to high)
TILE1.COUNTER_2.reset = "FSM_2.OUT";
// mode0 - Enables Counting when high
TILE1.COUNTER_2.mode0 = "FSM_2.S0";
// Name
TILE1.OUTLUT_0.$name = "OUTLUT_0";
// Name
TILE1.OUTLUT_1.$name = "OUTLUT_1";
// Name
TILE1.OUTLUT_2.$name = "OUTLUT_2";
// Name
TILE1.OUTLUT_3.$name = "OUTLUT_3";
// eqn - Boolean equation on the variables i2,i1,i0 for the OUTLUT output.
TILE1.OUTLUT_3.eqn = "0";
// Name
TILE1.OUTLUT_4.$name = "OUTLUT_4";
// i1 - Input 1.
TILE1.OUTLUT_4.i1 = "BOUNDARY.in0";
// eqn - Boolean equation on the variables i2,i1,i0 for the OUTLUT output.
TILE1.OUTLUT_4.eqn = "i0 & i1";
// i0 - Input 0.
TILE1.OUTLUT_4.i0 = "FSM_1.S0";
// Name
TILE1.OUTLUT_5.$name = "OUTLUT_5";
// i0 - Input 0.
TILE1.OUTLUT_5.i0 = "FSM_2.S0";
// eqn - Boolean equation on the variables i2,i1,i0 for the OUTLUT output.
TILE1.OUTLUT_5.eqn = "i0";
// Name
TILE1.OUTLUT_6.$name = "OUTLUT_6";
// Name
TILE1.OUTLUT_7.$name = "OUTLUT_7";
// Name
TILE1.HLC.$name = "HLC_0";
// R0_init - Initial value for register R0
TILE1.HLC.R0_init = "6";
// R1_init - Initial value for register R1
TILE1.HLC.R1_init = "9";
// Name
TILE1.HLC.program0.$name = "HLCP_0";
// Name
TILE1.HLC.program1.$name = "HLCP_1";
// Name
TILE1.HLC.program2.$name = "HLCP_2";
// Name
TILE1.HLC.program3.$name = "HLCP_3";
var clb_run_dynamic_template_clb_h = scripting.addModule("/utilities/clb_tool/clb_syscfg/source/clb_run_dynamic_template_clb_h.js");
var clb_run_dynamic_template_clb_c = scripting.addModule("/utilities/clb_tool/clb_syscfg/source/clb_run_dynamic_template_clb_c.js");
var clb_run_dynamic_template_clb_sim = scripting.addModule("/utilities/clb_tool/clb_syscfg/source/clb_run_dynamic_template_clb_sim.js");
var clb_run_dynamic_template_clb_dot = scripting.addModule("/utilities/clb_tool/clb_syscfg/source/clb_run_dynamic_template_clb_dot.js");
// Name
TILE2.$name = "TILE2";
// Name
TILE2.BOUNDARY.$name = "BOUNDARY1";
// in4
TILE2.BOUNDARY.in4 = "squareWave";
// in2
TILE2.BOUNDARY.in2 = "squareWave";
// in7
TILE2.BOUNDARY.in7 = "TILE1_BOUNDARY.out4";
// in_period0 - Period of the square wave
TILE2.BOUNDARY.in_period0 = 10000;
// in_duty0 - Duty or ON time of the square wave
TILE2.BOUNDARY.in_duty0 = 5000;
// in0
TILE2.BOUNDARY.in0 = "1";
// in1
TILE2.BOUNDARY.in1 = "squareWave";
// in_edge2 - Edge detection on the inputs, generates 1 cycle pulse on chosen edges - for simulation purposes only
TILE2.BOUNDARY.in_edge2 = "both edges";
// in_edge4 - Edge detection on the inputs, generates 1 cycle pulse on chosen edges - for simulation purposes only
TILE2.BOUNDARY.in_edge4 = "both edges";
// in_period1 - Period of the square wave
TILE2.BOUNDARY.in_period1 = 500;
// in_duty1 - Duty or ON time of the square wave
TILE2.BOUNDARY.in_duty1 = 250;
// in_period2 - Period of the square wave
TILE2.BOUNDARY.in_period2 = 500;
// in_duty2 - Duty or ON time of the square wave
TILE2.BOUNDARY.in_duty2 = 250;
// in_period4 - Period of the square wave
TILE2.BOUNDARY.in_period4 = 500;
// in_duty4 - Duty or ON time of the square wave
TILE2.BOUNDARY.in_duty4 = 250;
// Name
TILE2.LUT_0.$name = "LUT_3";
// eqn - Boolean equation on the variables i3,i2,i1,i0 for the LUT output.
TILE2.LUT_0.eqn = "i0 & (i1 | i2)";
// i0 - Input 0.
TILE2.LUT_0.i0 = "BOUNDARY.in0";
// i1 - Input 1.
TILE2.LUT_0.i1 = "BOUNDARY.in2";
// i2 - Input 2.
TILE2.LUT_0.i2 = "BOUNDARY.in4";
// Name
TILE2.LUT_1.$name = "LUT_4";
// eqn - Boolean equation on the variables i3,i2,i1,i0 for the LUT output.
TILE2.LUT_1.eqn = "(i2 & i1) | ((~i2) & i0)";
// i0 - Input 0.
TILE2.LUT_1.i0 = "FSM_0.OUT";
// i1 - Input 1.
TILE2.LUT_1.i1 = "COUNTER_0.count_match2";
// i2 - Input 2.
TILE2.LUT_1.i2 = "BOUNDARY.in7";
// Name
TILE2.LUT_2.$name = "LUT_5";
// eqn - Boolean equation on the variables i3,i2,i1,i0 for the LUT output.
TILE2.LUT_2.eqn = "(i2 & i0) | ((~i2) & i1)";
// i0 - Input 0.
TILE2.LUT_2.i0 = "FSM_0.OUT";
// i1 - Input 1.
TILE2.LUT_2.i1 = "COUNTER_0.count_match2";
// i2 - Input 2.
TILE2.LUT_2.i2 = "BOUNDARY.in7";
// Name
TILE2.FSM_0.$name = "FSM_3";
// eqn_s0 - Boolean equation on the variables e1,e0,s1,s0 for the S0 output.
TILE2.FSM_0.eqn_s0 = "e0";
// eqn_s1 - Boolean equation on the variables e1,e0,s1,s0 for the S1 output.
TILE2.FSM_0.eqn_s1 = "s1";
// eqn_out - Boolean equation on the variables e1,e0,s1,s0 for the LUT output.
TILE2.FSM_0.eqn_out = "(~s0) & e0";
// e0 - External Input 0.
TILE2.FSM_0.e0 = "COUNTER_0.count_match1";
// Name
TILE2.FSM_1.$name = "FSM_4";
// eqn_s1 - Boolean equation on the variables e1,e0,s1,s0 for the S1 output.
TILE2.FSM_1.eqn_s1 = "s0";
// eqn_out - Boolean equation on the variables e1,e0,s1,s0 for the LUT output.
TILE2.FSM_1.eqn_out = "s0 | s1";
// eqn_s0 - Boolean equation on the variables e1,e0,s1,s0 for the S0 output.
TILE2.FSM_1.eqn_s0 = "((~s0) & (e0)) | (s0 & (~e0))";
// e0 - External Input 0.
TILE2.FSM_1.e0 = "LUT_1.OUT";
// Name
TILE2.FSM_2.$name = "FSM_5";
// eqn_out - Boolean equation on the variables e1,e0,s1,s0 for the LUT output.
TILE2.FSM_2.eqn_out = "s0";
// eqn_s1 - Boolean equation on the variables e1,e0,s1,s0 for the S1 output.
TILE2.FSM_2.eqn_s1 = "s1";
// e0 - External Input 0.
TILE2.FSM_2.e0 = "LUT_2.OUT";
// eqn_s0 - Boolean equation on the variables e1,e0,s1,s0 for the S0 output.
TILE2.FSM_2.eqn_s0 = "((~s0) & (e0)) | (s0 & (~e0))";
// Name
TILE2.COUNTER_0.$name = "COUNTER_3";
// match1_val - Sets the value of the Match reference 1 register.
TILE2.COUNTER_0.match1_val = "4";
// match2_val - Sets the value of the Match reference 2 register.
TILE2.COUNTER_0.match2_val = "8";
// mode1 - Controls counting direction. High enables count up. Low enables count down.
TILE2.COUNTER_0.mode1 = "1";
// reset - Reset the counter to 0 on next clock cycle (triggers low to high)
TILE2.COUNTER_0.reset = "COUNTER_0.count_match2";
// mode0 - Enables Counting when high
TILE2.COUNTER_0.mode0 = "LUT_0.OUT";
// Name
TILE2.COUNTER_1.$name = "COUNTER_4";
// Name
TILE2.COUNTER_2.$name = "COUNTER_5";
// match1_val - Sets the value of the Match reference 1 register.
TILE2.COUNTER_2.match1_val = "40";
// Name
TILE2.OUTLUT_0.$name = "OUTLUT_8";
// eqn - Boolean equation on the variables i2,i1,i0 for the OUTLUT output.
TILE2.OUTLUT_0.eqn = "i0";
// i0 - Input 0.
TILE2.OUTLUT_0.i0 = "FSM_1.S0";
// Name
TILE2.OUTLUT_1.$name = "OUTLUT_9";
// eqn - Boolean equation on the variables i2,i1,i0 for the OUTLUT output.
TILE2.OUTLUT_1.eqn = "1";
// Name
TILE2.OUTLUT_2.$name = "OUTLUT_10";
// i0 - Input 0.
TILE2.OUTLUT_2.i0 = "FSM_2.S0";
// eqn - Boolean equation on the variables i2,i1,i0 for the OUTLUT output.
TILE2.OUTLUT_2.eqn = "i0";
// Name
TILE2.OUTLUT_3.$name = "OUTLUT_11";
// eqn - Boolean equation on the variables i2,i1,i0 for the OUTLUT output.
TILE2.OUTLUT_3.eqn = "1";
// Name
TILE2.OUTLUT_4.$name = "OUTLUT_12";
// eqn - Boolean equation on the variables i2,i1,i0 for the OUTLUT output.
TILE2.OUTLUT_4.eqn = "i0";
// i0 - Input 0.
TILE2.OUTLUT_4.i0 = "BOUNDARY.in1";
// Name
TILE2.OUTLUT_5.$name = "OUTLUT_13";
// eqn - Boolean equation on the variables i2,i1,i0 for the OUTLUT output.
TILE2.OUTLUT_5.eqn = "0";
// Name
TILE2.OUTLUT_6.$name = "OUTLUT_14";
// Name
TILE2.OUTLUT_7.$name = "OUTLUT_15";
// Name
TILE2.HLC.$name = "HLC_1";
// Name
TILE2.HLC.program0.$name = "HLCP_4";
// Name
TILE2.HLC.program1.$name = "HLCP_5";
// Name
TILE2.HLC.program2.$name = "HLCP_6";
// Name
TILE2.HLC.program3.$name = "HLCP_7";
