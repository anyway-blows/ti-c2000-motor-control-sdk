/**
 * @cliArgs --device "F28002x" --package "80QFP" --part "F28002x_80QFP" --product "C2000WARE@3.00.00.00"
 * @versions {"data":"2020090214","timestamp":"2020090214","tool":"1.6.0+1543","templates":"2020090214"}
 */

/**
 * Import the modules used in this configuration.
 */
const TILE                             = scripting.addModule("/utilities/clb_tool/clb_syscfg/source/TILE");
const TILE1                            = TILE.addInstance();
const clb_run_dynamic_template_clb_c   = scripting.addModule("/utilities/clb_tool/clb_syscfg/source/clb_run_dynamic_template_clb_c.js");
const clb_run_dynamic_template_clb_dot = scripting.addModule("/utilities/clb_tool/clb_syscfg/source/clb_run_dynamic_template_clb_dot.js");
const clb_run_dynamic_template_clb_h   = scripting.addModule("/utilities/clb_tool/clb_syscfg/source/clb_run_dynamic_template_clb_h.js");
const clb_run_dynamic_template_clb_sim = scripting.addModule("/utilities/clb_tool/clb_syscfg/source/clb_run_dynamic_template_clb_sim.js");

/**
 * Write custom configuration values to the imported modules.
 */
TILE1.$name                = "TILE1";
TILE1.BOUNDARY.$name       = "BOUNDARY0";
TILE1.LUT_0.$name          = "LUT_0";
TILE1.LUT_1.$name          = "LUT_1";
TILE1.LUT_2.$name          = "LUT_2";
TILE1.FSM_0.$name          = "FSM_0";
TILE1.FSM_0.eqn_out        = "0";
TILE1.FSM_0.e0             = "BOUNDARY.in0";
TILE1.FSM_0.e1             = "COUNTER_0.count_match1";
TILE1.FSM_0.eqn_s1         = "(e0 | s1) & (~e1)";
TILE1.FSM_0.eqn_s0         = "0";
TILE1.FSM_1.$name          = "FSM_1";
TILE1.FSM_2.$name          = "FSM_2";
TILE1.COUNTER_0.$name      = "COUNTER_0";
TILE1.COUNTER_0.reset      = "COUNTER_0.count_match1";
TILE1.COUNTER_0.mode0      = "FSM_0.S1";
TILE1.COUNTER_0.mode1      = "1";
TILE1.COUNTER_0.match1_val = "4995";
TILE1.COUNTER_1.$name      = "COUNTER_1";
TILE1.COUNTER_2.$name      = "COUNTER_2";
TILE1.OUTLUT_0.$name       = "OUTLUT_0";
TILE1.OUTLUT_1.$name       = "OUTLUT_1";
TILE1.OUTLUT_2.$name       = "OUTLUT_2";
TILE1.OUTLUT_3.$name       = "OUTLUT_3";
TILE1.OUTLUT_4.$name       = "OUTLUT_4";
TILE1.OUTLUT_5.$name       = "OUTLUT_5";
TILE1.OUTLUT_5.i0          = "COUNTER_0.count_match1";
TILE1.OUTLUT_5.eqn         = "i0";
TILE1.OUTLUT_6.$name       = "OUTLUT_6";
TILE1.OUTLUT_7.$name       = "OUTLUT_7";
TILE1.OUTLUT_7.i0          = "BOUNDARY.in0";
TILE1.OUTLUT_7.eqn         = "i0";
TILE1.HLC.$name            = "HLC_0";
TILE1.HLC.program0.$name   = "HLCP_0";
TILE1.HLC.program1.$name   = "HLCP_1";
TILE1.HLC.program2.$name   = "HLCP_2";
TILE1.HLC.program3.$name   = "HLCP_3";
TILE1.AOC_0.$name          = "AOC_0";
TILE1.AOC_1.$name          = "AOC_1";
TILE1.AOC_2.$name          = "AOC_2";
TILE1.AOC_3.$name          = "AOC_3";
TILE1.AOC_4.$name          = "AOC_4";
TILE1.AOC_5.$name          = "AOC_5";
TILE1.AOC_6.$name          = "AOC_6";
TILE1.AOC_7.$name          = "AOC_7";
